## config/boards/shields/proXiao/Kconfig.shield
```kconfig
# Copyright (c) 2020 The ZMK Contributors
# SPDX-License-Identifier: MIT

config SHIELD_SOFLE_LEFT
	def_bool $(shields_list_contains,proXiao_left)

config SHIELD_SOFLE_RIGHT
	def_bool $(shields_list_contains,proXiao_right)
```
